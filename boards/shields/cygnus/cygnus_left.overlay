#include "cygnus.dtsi"

/{
    esb_split {
        compatible = "zmk,esb-split";
        // These are arbitrary default addresses. In end user products
        // different addresses should be used for each set of devices.
        base-addr-0 = <0xA2 0xE3 0x0E 0x4E>;
        base-addr-1 = <0x52 0xF5 0x83 0xD4>;
        addr-prefix = <0x36 0xC3 0xDC 0x5B 0xD8 0x10 0x0D 0x7D>;
    };
};
/ {
    chosen {
        zmk,kscan = &kscan;
    };

    kscan: kscan {
        compatible = "zmk,kscan-gpio-matrix";
        wakeup-source;

        diode-direction = "col2row";

        row-gpios = <&xiao_d 0 (GPIO_ACTIVE_HIGH | GPIO_PULL_DOWN)>
                    , <&xiao_d 1 (GPIO_ACTIVE_HIGH | GPIO_PULL_DOWN)>
                    , <&xiao_d 2 (GPIO_ACTIVE_HIGH | GPIO_PULL_DOWN)>
                    , <&xiao_d 3 (GPIO_ACTIVE_HIGH | GPIO_PULL_DOWN)>
                    ;

        col-gpios = <&xiao_d 4  GPIO_ACTIVE_HIGH >
                    , <&xiao_d 5  GPIO_ACTIVE_HIGH >
                    , <&xiao_d 6  GPIO_ACTIVE_HIGH >
                    , <&xiao_d 7  GPIO_ACTIVE_HIGH >
                    , <&xiao_d 8  GPIO_ACTIVE_HIGH >
                    , <&xiao_d 9  GPIO_ACTIVE_HIGH >
                    ;
    };
};




