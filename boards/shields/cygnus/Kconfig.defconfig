## boards/shields/cygnus/Kconfig.defconfig
```kconfig
if SHIELD_CYGNUS_DONGLE

config ZMK_KEYBOARD_NAME
    default "Cygnus"

config ZMK_SPLIT_ROLE_CENTRAL
    default y

endif

if SHIELD_CYGNUS_LEFT || SHIELD_CYGNUS_RIGHT || SHIELD_CYGNUS_DONGLE

config ZMK_SPLIT
    default y

endif
```
