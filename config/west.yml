## config/west.yml
```yaml
manifest:
  remotes:
    - name: zmkfirmware
      url-base: https://github.com/zmkfirmware
    - name: badjeff
      url-base: https://github.com/badjeff
    - name: nrfconnect
      url-base: https://github.com/nrfconnect
  # Additional modules containing boards/shields/custom code can be listed here as well
  # See https://docs.zephyrproject.org/3.2.0/develop/west/manifest.html#projects
  projects:
    - name: zmk
      remote: zmkfirmware
      revision: main   
      import: app/west.yml
    - name: zmk-feature-split-esb
      remote: badjeff
      revision: main  
    - name: sdk-nrf
      remote: badjeff
      revision: v3.1-branch+zmk-fixes 
      path: nrf
    - name: nrfxlib
      remote: nrfconnect
      revision: v3.1-branch
      repo-path: sdk-nrfxlib
      path: nrfxlib
    - name: zmk-component-zongle
      remote: vuoz
      revision: main

  self:
    path: config
```
